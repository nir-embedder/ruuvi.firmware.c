## nrf54_zephyr/tests/aes_vector/testcase.yaml
```yaml
tests:
  ruuvi.aes_vector:
    tags:
      - crypto
    integration_platforms:
      - qemu_cortex_m3
```

## nrf54_zephyr/tests/gatt/testcase.yaml
```yaml
tests:
  ruuvi.gatt.rx_queue:
    tags:
      - bluetooth
    integration_platforms:
      - mps2/an385
  ruuvi.gatt.rx_queue_history:
    tags:
      - bluetooth
    integration_platforms:
      - mps2/an385
    extra_args:
      - RUUVI_TEST_HISTORY=1
    extra_dtc_overlay_files:
      - ../history_flash/mps2_history.overlay
```

## nrf54_zephyr/tests/history_flash/testcase.yaml
```yaml
tests:
  ruuvi.history_flash.simulator:
    tags:
      - storage
    integration_platforms:
      - mps2/an385
    extra_dtc_overlay_files:
      - mps2_history.overlay
```

## nrf54_zephyr/tests/nfc_codec/testcase.yaml
```yaml
tests:
  ruuvi.nfc_codec:
    tags:
      - nfc
    integration_platforms:
      - qemu_cortex_m3
```

## nrf54_zephyr/tests/sensors/dts/bindings/sensor/ruuvi,motion-test.yaml
```yaml
description: Mock motion and environmental channels for QEMU-only application tests
compatible: "ruuvi,motion-test"
include: base.yaml
```

## nrf54_zephyr/tests/sensors/testcase.yaml
```yaml
tests:
  ruuvi.sensors.motion_trigger:
    tags:
      - sensor
    integration_platforms:
      - mps2/an385
    extra_dtc_overlay_files:
      - mps2_motion.overlay
```

## nrf54_zephyr/tests/ui/testcase.yaml
```yaml
tests:
  ruuvi.ui.gpio_emulator:
    tags:
      - gpio
    integration_platforms:
      - mps2/an385
    extra_dtc_overlay_files:
      - mps2_ui.overlay
```
